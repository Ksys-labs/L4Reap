## kernel/fiasco/src/kern/arm/bsp/omap3/Kconfig
```kconfig
# PF: OMAP
# PFDESCR: TI OMAP
# PFDEPENDS: ARM

choice
	prompt "OMAP Platform"
	default PF_OMAP3_EVM

config PF_OMAP3_EVM
	bool "TI OMAP3EVM"
	depends on PF_OMAP
	select CAN_ARM_CPU_CORTEX_A8
	help
	  Choose for OMAP3EVM.

config PF_OMAP3_BEAGLEBOARD
	bool "Beagle Board"
	depends on PF_OMAP
	select CAN_ARM_CPU_CORTEX_A8
	help
	  Choose for Beagleboard.

config PF_OMAP4_PANDABOARD
	bool "Pandaboard"
	depends on PF_OMAP
	select CAN_ARM_CPU_CORTEX_A9
	help
	  Choose for Pandaboard.

endchoice
```

## kernel/fiasco/src/kern/arm/bsp/tegra2/Kconfig
```kconfig
# PF: TEGRA2
# PFDESCR: NVIDIA Tegra 2xx platform
# PFSELECT: CAN_ARM_CPU_CORTEX_A9 CAN_ARM_CACHE_L2CXX0
# PFDEPENDS: ARM

choice
	prompt "Platform Timer"
	default PF_TEGRA_TIMER_MP

config PF_TEGRA_TIMER_MP
	bool "MP timer"
	help
	  ARM local-core multi-processor timer.

config PF_TEGRA_TIMER_TMR
	bool "TMR timer"
	help
	  Single broadcasting timer.

endchoice
```

## l4/mk/Kconfig
```kconfig
mainmenu "L4Re Configuration"

config KERNELVERSION
        string
	option env="KERNELVERSION"

choice
	prompt "Target Architecture"
	default BUILD_ARCH_x86
	help
	  Specify for which processor architecture you want to build.

config BUILD_ARCH_x86
	bool "X86-32 architecture"

config BUILD_ARCH_amd64
	bool "AMD64 architecture"

config BUILD_ARCH_arm
	bool "ARM architecture"

config BUILD_ARCH_ppc32
	bool "PowerPC 32 architecture (EXPERIMENTAL!)"

config BUILD_ARCH_sparc
	bool "Sparc architecture (EXPERIMENTAL)"

endchoice

config BUILD_ARCH
	string
	default "x86"   if BUILD_ARCH_x86
	default "arm"   if BUILD_ARCH_arm
	default "amd64" if BUILD_ARCH_amd64
	default "ppc32" if BUILD_ARCH_ppc32
	default "sparc" if BUILD_ARCH_sparc

# currently we have nothing for abi linux, so just do not offer this option
#choice
#	prompt "ABI"
#	default BUILD_ABI_l4f
#
#config BUILD_ABI_l4f
#	bool "L4/Fiasco"
#
#config BUILD_ABI_linux
#	bool "Linux"
#
#endchoice
config BUILD_ABI_l4f
	def_bool y


config BUILD_ABI
	string
	default "l4f"   if BUILD_ABI_l4f
	default "linux" if BUILD_ABI_linux

if BUILD_ARCH_x86 || BUILD_ARCH_amd64

choice
	prompt "CPU variant"
	
config CPU_X86_586
	bool "586 type CPU"
	depends on BUILD_ARCH_x86

config CPU_X86_PENTIUM
	bool "Pentium type CPU"
	depends on BUILD_ARCH_x86

config CPU_X86_PENTIUMMMX
	bool "Pentium with MMX type CPU"
	depends on BUILD_ARCH_x86

config CPU_X86_PENTIUMPRO
	bool "Pentium Pro type CPU"
	depends on BUILD_ARCH_x86

config CPU_X86_686
	bool "686 type CPU"
	depends on BUILD_ARCH_x86

config CPU_X86_PENTIUM2
	bool "Pentium2 type CPU"
	depends on BUILD_ARCH_x86

config CPU_X86_PENTIUM3
	bool "Pentium3 type CPU"
	depends on BUILD_ARCH_x86

config CPU_X86_PENTIUMM
	bool "Pentium-M type CPU"
	depends on BUILD_ARCH_x86

config CPU_X86_PENTIUM4
	bool "Pentium4 type CPU"
	depends on BUILD_ARCH_x86

config CPU_X86_PRESCOTT
	bool "Pentium4 Prescott type CPU"
	depends on BUILD_ARCH_x86

config CPU_X86_NOCONA
	bool "Pentium Nocona type CPU"
	depends on BUILD_ARCH_x86

config CPU_X86_CORE2
	bool "Core2 type CPU"
	depends on BUILD_ARCH_x86

config CPU_X86_K6
	bool "K6 type CPU"
	depends on BUILD_ARCH_x86

config CPU_X86_K7
	bool "K7 type CPU"
	depends on BUILD_ARCH_x86

config CPU_X86_ATHLON4
	bool "Athlon type CPU"
	depends on BUILD_ARCH_x86

config CPU_X86_K8
	bool "K8 type CPU"
	depends on BUILD_ARCH_x86 || BUILD_ARCH_amd64

config CPU_X86_K10
	bool "K10/Barcelona type CPU"
	depends on BUILD_ARCH_x86 || BUILD_ARCH_amd64

config CPU_X86_OPTERON
	bool "Opteron type CPU"
	depends on BUILD_ARCH_x86 || BUILD_ARCH_amd64



endchoice


config CPU
	string
	default "586"        if CPU_X86_586
	default "pentium"    if CPU_X86_PENTIUM
	default "pentiummmx" if CPU_X86_PENTIUMMMX
	default "pentiumpro" if CPU_X86_PENTIUMPRO
	default "686"        if CPU_X86_686
	default "pentium2"   if CPU_X86_PENTIUM2
	default "pentium3"   if CPU_X86_PENTIUM3
	default "pentiumm"   if CPU_X86_PENTIUMM
	default "pentium4"   if CPU_X86_PENTIUM4
	default "prescott"   if CPU_X86_PRESCOTT
	default "core2"      if CPU_X86_CORE2
	default "nocona"     if CPU_X86_NOCONA
	default "K6"         if CPU_X86_K6
	default "K7"         if CPU_X86_K7
	default "athlon4"    if CPU_X86_ATHLON4
	default "K8"         if CPU_X86_K8
	default "amdfam10"   if CPU_X86_K10
	default "opteron"    if CPU_X86_OPTERON
endif


if BUILD_ARCH_arm

choice
	prompt "CPU variant"
	
config CPU_ARM_ARMV4
	bool "ARMv4 type CPU"
	depends on BUILD_ARCH_arm

config CPU_ARM_ARMV4T
	bool "ARMv4T type CPU"
	depends on BUILD_ARCH_arm

config CPU_ARM_ARMV5
	bool "ARMv5 type CPU"
	depends on BUILD_ARCH_arm

config CPU_ARM_ARMV5T
	bool "ARMv5T type CPU"
	depends on BUILD_ARCH_arm

config CPU_ARM_ARMV5TE
	bool "ARMv5TE type CPU"
	depends on BUILD_ARCH_arm

config CPU_ARM_ARMV6
	bool "ARMv6 type CPU"
	depends on BUILD_ARCH_arm

config CPU_ARM_ARMV6T2
	bool "ARMv6t2 type CPU"
	depends on BUILD_ARCH_arm

config CPU_ARM_ARMV6ZK
	bool "ARMv6zk type CPU"
	depends on BUILD_ARCH_arm

config CPU_ARM_ARMV7A
	bool "ARMv7A type CPU"
	depends on BUILD_ARCH_arm

config CPU_ARM_ARMV7R
	bool "ARMv7R type CPU"
	depends on BUILD_ARCH_arm

endchoice

config CPU
	string
	default "armv4"    if CPU_ARM_ARMV4
	default "armv4t"   if CPU_ARM_ARMV4T
	default "armv5"    if CPU_ARM_ARMV5
	default "armv5t"   if CPU_ARM_ARMV5T
	default "armv5te"  if CPU_ARM_ARMV5TE
	default "armv6"    if CPU_ARM_ARMV6
	default "armv6t2"  if CPU_ARM_ARMV6T2
	default "armv6zk"  if CPU_ARM_ARMV6ZK
	default "armv7a"   if CPU_ARM_ARMV7A
	default "armv7r"   if CPU_ARM_ARMV7R

config CPU_ARMV6KPLUS
	bool
	default y if CPU_ARM_ARMV6ZK || CPU_ARM_ARMV7A || CPU_ARM_ARMV7R

config CPU_ARMV6PLUS
	bool
	default y if CPU_ARM_ARMV6 || CPU_ARM_ARMV6T2 || CPU_ARMV6KPLUS

menu "Platform"

choice
	prompt "ARM Platform"

config PLATFORM_ARM_integrator
	bool "ARM Integrator"
	
config PLATFORM_ARM_rv
	bool "ARM Realview"

config PLATFORM_ARM_imx21
	bool "Freescale i.MX21"

config PLATFORM_ARM_imx51
	bool "Freescale i.MX51"

config PLATFORM_ARM_omap3evm
	bool "TI OMAP3EVM"

config PLATFORM_ARM_beagleboard
	bool "Beagleboard"

config PLATFORM_ARM_pandaboard
	bool "Pandaboard"

config PLATFORM_ARM_tegra2
	bool "NVIDIA Tegra 2"

config PLATFORM_ARM_custom
	bool "Custom platform"

endchoice

if PLATFORM_ARM_integrator

config ARM_PLATFORM_TYPE
	string
	default "integrator"

config RAM_BASE
	hex
	default 0x0

config RAM_SIZE_MB
	int
	default 256

endif

if PLATFORM_ARM_rv

config ARM_PLATFORM_TYPE
	string
	default "rv"

config RAM_BASE
	hex
	default 0x0

config RAM_SIZE_MB
	int
	default 256

endif

if PLATFORM_ARM_imx21

config ARM_PLATFORM_TYPE
	string
	default "imx21"

config RAM_BASE
	hex
	default 0xc0000000

config RAM_SIZE_MB
	int
	default 64
endif

if PLATFORM_ARM_imx51

config ARM_PLATFORM_TYPE
	string
	default "imx51"

config RAM_BASE
	hex
	default 0x90000000

config RAM_SIZE_MB
	int
	default 512
endif

if PLATFORM_ARM_omap3evm

config ARM_PLATFORM_TYPE
	string
	default "omap3evm"

config RAM_BASE
	hex
	default 0x80000000

config RAM_SIZE_MB
	int
	default 128
endif

if PLATFORM_ARM_beagleboard

config ARM_PLATFORM_TYPE
	string
	default "beagleboard"

config RAM_BASE
	hex
	default 0x80000000

config RAM_SIZE_MB
	int
	default 128
endif

if PLATFORM_ARM_pandaboard

config ARM_PLATFORM_TYPE
	string
	default "pandaboard"

config RAM_BASE
	hex
	default 0x80000000

config RAM_SIZE_MB
	int
	default 512
endif

if PLATFORM_ARM_tegra2

config ARM_PLATFORM_TYPE
	string
	default "tegra2"

config RAM_BASE
	hex
	default 0x0

config RAM_SIZE_MB
	int
	default 64
endif

if PLATFORM_ARM_custom


config ARM_PLATFORM_TYPE
	string "Name of your platform"
	depends on BUILD_ARCH_arm

config RAM_BASE
	hex "Start of RAM"
	depends on BUILD_ARCH_arm
	default 0x0
	help
	  Hexadecimal physical address where RAM memory starts on the
	  platform.

config RAM_SIZE_MB
	int "RAM-Memory available on the platform in MB"
	depends on BUILD_ARCH_arm
	default 128

endif

endmenu

endif



if BUILD_ARCH_ppc32

config CPU
	string "CPU variant"
	default "603e"

menu "Platform"

choice
	prompt "Platform"

config PLATFORM_PPC_mpc5200
	bool "MPC52xx"

endchoice

if PLATFORM_PPC_mpc5200

config PPC_PLATFORM_TYPE
	string
	default "mpc5200"

config RAM_BASE
	hex
	default 0x0

config RAM_SIZE_MB
	int "RAM-Memory available on the platform in MB"
	default 64

endif

endmenu

endif




if BUILD_ARCH_sparc

config CPU
	string "Sparc CPU variant"
	default "v8"

config PLATFORM_SPARC_leon3
	def_bool y

if PLATFORM_SPARC_leon3

config SPARC_PLATFORM_TYPE
	string
	default "leon3"

config RAM_BASE
	hex
	default 0x0

config RAM_SIZE_MB
	int "RAM-Memory available on the platform in MB"
	default 64


endif

endif


config USE_DROPS_STDDIR
	def_bool n

config USE_DICE
	def_bool n

config DROPS_STDDIR
	string
	default "/path/to/l4re"

config DROPS_INSTDIR
	string
	default "/path/to/l4re"

config BID_COLORED_PHASES
	bool
	default y

menu "Building"

#menu "Compilers and Tools"
#config BIDc_USE_SPECIAL_CC
#	bool "Use special C-Compilers"
#if BIDc_USE_SPECIAL_CC
#endif
#endmenu

config YACC
	string
	default "yacc"

config LEX
	string
	default "flex"

config CTAGS
	string
	default "ctags"

config ETAGS
	string
	default "etags"


config HAVE_LDSO
	def_bool y

config INT_CPP_NAME_SWITCH
	bool "Automatically determine internal gcc preprocessor names"
	default y

config INT_LD_NAME_SWITCH
	bool "Automatically determine internal ld names"
	default y

config INT_PP_NAME
	string "Internal name of the compiler preprocessor"
	default "cpp0"
	depends on !INT_CPP_NAME_SWITCH

config INT_LD_NAME
	string "Internal name of the compiler linker"
	default "ld"
	depends on !INT_LD_NAME_SWITCH


config BID_STRIP_PROGS
	bool "Strip binaries on install"
	default n
	help
	  If enabled, binaries will be stripped on installation into
	  $(L4DIR)/bin or $(DROPS_STDDIR)/bin. If you want to load them with
	  all their symbols (eg to show the symbols with the Fiasco kernel
	  debugger), say 'N' here.

	  If unsure, say 'Y'.

config BID_GCC_OMIT_FP
	bool "GCC: Omit Frame-pointers"
	default n
	help
	  If enabled, gcc will be passed the '-fomit-frame-pointer' cmdline
	  option, adding an additional register to the register set for the
	  generated code. Programs will be faster, but backtraces cannot be
	  done, seriously hindering debugging.

	  If unsure, say 'N'.


config BID_GENERATE_MAPFILE
	bool #"Generate Map-files for binaries"
	default n
	help
	  Enabling this option will generate map-files together with the
	  binaries. This might be handy for debugging purposes. See ld(1)
	  for details on mapfiles.

          If unsure, say N.

config BID_BUILD_DOC
	bool "Build doc directories"
	default n
	help
	  Say Y if you also want to build the doc directories.

config RELEASE_MODE
	bool "Enable RELEASE flag"
	help
	  Enable to leave out debugging and other code normally not needed.

	  Say N.


config LABEL
	string "Configuration label"
	help
	  Name for the configuration. The build system will also try to
	  include a file Makeconf.<label> from the build directory root and
	  the l4 directory root.

endmenu
```
